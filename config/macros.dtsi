macro_ctrl_space: macro_ctrl_space{
compatible = "zmk,behavior-macro";
label = "macro_ctrl_space";
#binding-cells = <0>;
bindings = <&sk RCTRL>, <&kp SPACE>;
};
macro_kinesis: macro_kinesis{
compatible = "zmk,behavior-macro";
label = "macro_kinesis";
#binding-cells = <0>;
bindings = <&kp LS(K)>, <&kp I>, <&kp N>, <&kp E>, <&kp S>, <&kp I>, <&kp S>;
};